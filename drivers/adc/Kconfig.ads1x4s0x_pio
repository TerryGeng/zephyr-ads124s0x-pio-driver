## drivers/adc/Kconfig.ads1x4s0x_pio
```kconfig
menuconfig ADC_ADS1X4S0X_PIO
	bool "Texas instruments ADS1X4S0X on PIO"
	default y
	depends on DT_HAS_TI_ADS114S06_PIO_ENABLED || DT_HAS_TI_ADS114S08_PIO_ENABLED \
		|| DT_HAS_TI_ADS124S06_PIO_ENABLED || DT_HAS_TI_ADS124S08_PIO_ENABLED
	select SPI
	select ADC_CONFIGURABLE_INPUTS
	select ADC_CONFIGURABLE_EXCITATION_CURRENT_SOURCE_PIN
	select ADC_CONFIGURABLE_VBIAS_PIN
	help
	  Enable the driver implementation for the ADS1X4S0X family

config ADC_ADS1X4S0X_PIO_ASYNC_THREAD_INIT_PRIO
	int "ADC ADS1X4S0X_PIO async thread priority"
	default 0
	depends on ADC_ADS1X4S0X_PIO

config ADC_ADS1X4S0X_PIO_ACQUISITION_THREAD_STACK_SIZE
	int "Stack size for the ADC data acquisition thread"
	default 400
	depends on ADC_ADS1X4S0X_PIO
	help
	  Size of the stack used for the internal data acquisition
	  thread.

config ADC_ADS1X4S0X_PIO_SM_INST_BUF_SIZE
	int "Size of instruction buffer size of the state machine"
	default 200
	depends on ADC_ADS1X4S0X_PIO
	help
	  Size of instruction buffer size of the state machine.
	  The worst case is 52.5 bytes per channel if each of them has
	  completely different configuration.
	  If multiplexing setting is the only difference between channels,
	  the number is 32.5 bytes per channel.

config ADC_ADS1X4S0X_PIO_GPIO
	bool "GPIO support"
	default n
	depends on GPIO && ADC_ADS1X4S0X_PIO
	help
	  Enable GPIO child device support in the ADS1X4S0X_PIO ADC driver.

	  The GPIO functionality is handled by the ADS1X4S0X_PIO GPIO
	  driver.

config ADC_ADS1X4S0X_PIO_WAIT_FOR_COMPLETION_TIMEOUT_MS
	int "Timeout for wait for completion of a read in ms"
	default 1000
	depends on ADC_ADS1X4S0X_PIO
	help
	  This is the wait time in ms until a read is completed.
```

## drivers/gpio/Kconfig.ads1x4s0x_pio
```kconfig
# ADS1X4S0X GPIO configuration options

# Copyright (c) 2023 SILA Embedded Solutions GmbH
# SPDX-License-Identifier: Apache-2.0

menuconfig GPIO_ADS1X4S0X_PIO
	bool "ADS1X4S0X_PIO GPIO driver"
	default y
	depends on DT_HAS_TI_ADS1X4S0X_PIO_GPIO_ENABLED
	depends on ADC_ADS1X4S0X_PIO_GPIO
	help
	  Enable GPIO driver for ADS1X4S0X_PIO.

	  The ADS1X4S0X_PIO is a multi-channel analog frontend (AFE).

	  The GPIO port of the ADS1X4S0X_PIO (GPIO0 to GPIO3) is exposed as a
	  GPIO controller driver with read/write support.

config GPIO_ADS1X4S0X_PIO_INIT_PRIORITY
	int "Driver init priority"
	default 99
	depends on GPIO_ADS1X4S0X_PIO
	help
	  Device driver initialization priority. This driver must be
	  initialized after the ADS1X4S0X_PIO ADC driver.
```

## dts/bindings/adc/ti,ads124s08-pio.yaml
```yaml
# Copyright (c) 2024 The Zephyr Project Contributors
# SPDX-License-Identifier: Apache-2.0

description: Texas Instrument 12 channels 24 bit SPI ADC

compatible: "ti,ads124s08-pio"

include: ti,ads1x4s0x-pio-base.yaml
```

## dts/bindings/adc/ti,ads1x4s0x-pio-base.yaml
```yaml
# Copyright (c) 2023 SILA Embedded Solutions GmbH
# SPDX-License-Identifier: Apache-2.0

include: ["adc-controller.yaml", "raspberrypi,pico-pio-device.yaml"]

bus: ads1x4s0x-pio

properties:
  "#io-channel-cells":
    const: 1

  reset-gpios:
    type: phandle-array
    description: "GPIO for reset"

  drdy-gpios:
    type: phandle-array
    required: true
    description: |
      GPIO for data ready, becomes active when a conversion result is ready

  start-sync-gpios:
    type: phandle-array
    description: |
      GPIO for start/sync, used to signal the ADC that a conversion should be started

  idac-current:
    type: int
    enum:
      - 0
      - 10
      - 50
      - 100
      - 250
      - 500
      - 750
      - 1000
      - 1500
      - 2000
    default: 0
    description: |
      IDAC current in microampere, the default value turns the current source off

  vbias-level:
    type: int
    enum:
      - 0
      - 1
    default: 0
    description: |
      bias voltage level: 0 - (AVDD+AVSS)/2, 1 - (AVDD+AVSS)/12

  clk-gpios:
    type: phandle-array
    required: true
    description: |
      Output pin for SPI clock

  mosi-gpios:
    type: phandle-array
    description: |
      Output pin for Master Out Slave In.

  miso-gpios:
    type: phandle-array
    description: |
      Input pin for Master In Slave Out.

  cs-gpios:
    type: phandle-array
    description: |
      Chip Select pin.

  spi-frequency:
    type: int
    required: true
    description: |
      SPI clock frequency the SPI peripheral is being driven at, in Hz.

  clocks:
    required: true

io-channel-cells:
  - input
```
